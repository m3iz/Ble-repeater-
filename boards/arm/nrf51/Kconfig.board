## boards/arm/nrf51/Kconfig.board
```kconfig
# Copyright (c) 2023 Nordic Semiconductor ASA
# SPDX-License-Identifier: Apache-2.0

config BOARD_NRF51
	bool "nrf51"
	depends on SOC_NRF51822_QFAA
```

## boards/arm/nrf51/Kconfig.defconfig
```kconfig
# Copyright (c) 2023 Nordic Semiconductor ASA
# SPDX-License-Identifier: Apache-2.0

if BOARD_NRF51

config BOARD
	default "nrf51"

config BT_CTLR
   default BT

endif
```

## boards/arm/repeater/Kconfig.defconfig
```kconfig
# Copyright (c) 2023 Nordic Semiconductor ASA
# SPDX-License-Identifier: Apache-2.0

if BOARD_REPEATER

config BOARD
	default "repeater"

config BT_CTLR
   default BT

endif
```
